## src/modules/experimental_control/Kconfig
```kconfig
menuconfig MODULES_EXPERIMENTAL_CONTROL
	bool "experimental_control"
	default n
	---help---
		Enable support for experimental_control

menuconfig USER_EXPERIMENTAL_CONTROL
	bool "experimental_control running as userspace module"
	default n
	depends on BOARD_PROTECTED && MODULES_EXPERIMENTAL_CONTROL
	---help---
		Put experimental_control in userspace memory
```

## src/modules/mc_custom_control/Kconfig
```kconfig
menuconfig MODULES_MC_CUSTOM_CONTROL
	bool "mc_custom_control"
	default n
	---help---
		Enable support for mc_custom_control

menuconfig USER_MC_CUSTOM_CONTROL
	bool "mc_custom_control running as userspace module"
	default n
	depends on BOARD_PROTECTED && MODULES_MC_CUSTOM_CONTROL
	---help---
		Put mc_custom_control in userspace memory
```

## src/modules/trim_selector/Kconfig
```kconfig
menuconfig MODULES_TRIM_SELECTOR
	bool "trim_selector"
	default n
	---help---
		Enable support for trim_selector

menuconfig USER_TRIM_SELECTOR
	bool "trim_selector running as userspace module"
	default y
	depends on BOARD_PROTECTED && MODULES_TRIM_SELECTOR
	---help---
		Put trim_selector in userspace memory
```
